## conf/machine/odroid-u2.conf
```bitbake
#-----------------------------------------------------------------------------
#@TYPE: Machine
#@NAME: ODROID-U2 (Exynos 4412)
#@DESCRIPTION: Machine configuration for the ODROID-U2 by hardkernel
#-----------------------------------------------------------------------------

TARGET_ARCH = "arm"

PREFERRED_PROVIDER_virtual/kernel ?= "linux-hardkernel"

KERNEL_IMAGETYPE = "zImage"
IMAGE_FSTYPES += "tar.gz"

require conf/machine/include/tune-cortexa8.inc
```
